## Kconfig
```kconfig
config UFW_ZEPHYR
	bool "Enable ufw-zephyr extensions"
	default n

if UFW_ZEPHYR

config UFW_SHELL_ADDONS
	bool "Enable ufw-zephyr's shell addons"
        depends on SHELL
	default n

config UFW_SLAB_ALLOCATOR
	bool "Allow using slab allocators as ufw BlockAllocators"
	default n

config UFW_SPI_TEXT
	bool "Enable ufw-zephyr's text based SPI controller"
	def_bool   DT_HAS_UFW_SPI_TEXT_ENABLED
	depends on DT_HAS_UFW_SPI_TEXT_ENABLED

config UFW_SPI_TEXT_INIT_PRIORITY
       int "Init priority for the spi-text driver"
       depends on UFW_SPI_TEXT
       default 70

endif # UFW_ZEPHYR
```
